## drivers/gpu/arm/mali/Kconfig
```kconfig
config MALI400
        bool "Enable MALI integration"
	depends on ARM
	select DMA_SHARED_BUFFER
        default n
        ---help---
                This enables MALI 3D graphics driver. Required to use hardware accelerated OpenGL ES 2.0 and 1.1.

config MALI400_UMP
        bool "Enable UMP support"
        depends on MALI400
        default y
        ---help---
                This enables support for the UMP memory sharing API in the Mali driver.

config MALI400_INTERNAL_PROFILING
	bool "Enable internal Mali profiling API"
        depends on MALI400
        default n
        ---help---
                This enables the internal legacy Mali profiling API.

config MALI400_PROFILING
        bool "Enable Mali profiling"
        depends on MALI400
	select TRACEPOINTS
        default n
        ---help---
                This enables gator profiling of Mali GPU events.

config MALI400_DEBUG
        bool "Enables debug messages"
        depends on MALI400
        default n
        ---help---
                This enables Mali driver debug messages.
```

## drivers/gpu/arm/umplock/Kconfig
```kconfig
config UMPLOCK
        bool "Enable Mali UMPLOCK"
        default y
	---help---
		This enables UMPLOCK driver
```
